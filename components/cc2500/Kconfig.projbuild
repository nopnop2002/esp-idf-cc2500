## components/cc2500/Kconfig.projbuild
```kconfig
menu "CC2500 Configuration"

	config GPIO_RANGE_MAX
		int
		default 33 if IDF_TARGET_ESP32
		default 46 if IDF_TARGET_ESP32S2
		default 19 if IDF_TARGET_ESP32C3
		default 48 if IDF_TARGET_ESP32S3

	config MISO_GPIO
		int "CC2500 MISO GPIO"
		range 0 GPIO_RANGE_MAX
		default 19 if IDF_TARGET_ESP32
		default 37 if IDF_TARGET_ESP32S2
		default 37 if IDF_TARGET_ESP32S3
		default 18 if IDF_TARGET_ESP32C3
		help
			Pin Number to be used as the MISO SPI signal.

	config SCK_GPIO
		int "CC2500 SCK GPIO"
		range 0 GPIO_RANGE_MAX
		default 18 if IDF_TARGET_ESP32
		default 36 if IDF_TARGET_ESP32S2
		default 36 if IDF_TARGET_ESP32S3
		default 10 if IDF_TARGET_ESP32C3
		help
			Pin Number to be used as the SCK SPI signal.

	config MOSI_GPIO
		int "CC2500 MOSI GPIO"
		range 0 GPIO_RANGE_MAX
		default 23 if IDF_TARGET_ESP32
		default 35 if IDF_TARGET_ESP32S2
		default 35 if IDF_TARGET_ESP32S3
		default 19 if IDF_TARGET_ESP32C3
		help
			Pin Number to be used as the MOSI SPI signal.

	config CSN_GPIO
		int "CC2500 CSN GPIO"
		range 0 GPIO_RANGE_MAX
		default 5  if IDF_TARGET_ESP32
		default 34 if IDF_TARGET_ESP32S2
		default 34 if IDF_TARGET_ESP32S3
		default 9  if IDF_TARGET_ESP32C3
		help
			Pin Number to be used as the CSN SPI signal.

	config CC2500_CHANNEL
		int "CC2500 channel"
		range 0 255
		default 0
		help
			Both receiver and transmitter must operate on the same channel

endmenu
```
